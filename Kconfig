## Kconfig
```kconfig
mainmenu "Dopi Configuration"
comment "Dopi Compile Menuconfig"
choice
    prompt "Platform"
    default HISILICON
    help
        Please choice Soc platform

    config HISILICON
        bool "Hisilicon"


endchoice
choice
    prompt "Hisilicon Soc"
    depends on HISILICON
    default HI3516EV200
    help
        Please choice Soc platform

    config HI3516EV200
        bool "HI3516EV200"

endchoice
menu "BSP"
	source "bsp/Kconfig"
endmenu
menu "vendor"
	source "vendor/Kconfig"
endmenu
menu "App"
	source "app/Kconfig"
endmenu
```

## app/Kconfig
```kconfig
config APP_NAME
    string "app name"
    default demo
choice APP_TEST_UNIT
    prompt "App example"
    default RTSP
    help
        Please choice app test example

    config APP_TEST_RTSP
        bool "RTSP Demo"
    config APP_TEST_FFMPEG
        bool "FFMPEG Demo"

endchoice

menuconfig APP_LIB
    bool "libraries"
	source "app/libraries/Kconfig"
```

## app/libraries/Kconfig
```kconfig
menuconfig APP_LIB_RTSP
    depends on APP_LIB
    bool "librtsp"
    default y
config APP_LIB_RTSP_URL
    depends on APP_LIB_RTSP
    string "librtsp git url"
    default "https://gitee.com/cijliu/librtsp.git"

menuconfig APP_LIB_LIBAV
    depends on APP_LIB && HI3516EV200_MPP
    bool "ffmpeg/libav"
    default y
config APP_LIB_LIBAV_URL
    depends on APP_LIB_LIBAV 
    string "ffmpeg/libav git url"
    default "https://gitee.com/cijliu/libav.git"

menu "Input Device"
    depends on APP_LIB_LIBAV
config LIBAV_DEVICES_V4L2
    bool "v4l2 device"
    default y
config LIBAV_DEVICES_HI3516EV200
    bool "hi3516ev200 mpp device"
    default y
endmenu

menu "Video Format"
    depends on APP_LIB_LIBAV
config LIBAV_VIDEO_FORMAT_YUV420
    bool "YUV420"
    default y
config LIBAV_VIDEO_FORMAT_H264
    bool "H264"
    default y
config LIBAV_VIDEO_FORMAT_H265
    bool "H265"
    default y
config LIBAV_VIDEO_FORMAT_MJPEG
    bool "MJPEG"
    default y
endmenu
```

## bsp/Kconfig
```kconfig
choice
    prompt "bsp source"
    default GIT
    help
        Please choice bsp source

    config GIT
        bool "git"
endchoice
choice
    prompt "bsp version"
    depends on GIT
    default V0_99
    help
        Please choice bsp version from git

    config V0_99
        bool "v0.99"

endchoice
menuconfig GIT_UBOOT
    depends on GIT
        bool "uboot"
        default y
if GIT_UBOOT
    config UBOOT_GIT_URL
        string "uboot git url"
        default "https://gitee.com/cijliu/uboot.git"
    choice
        prompt "flash type"
        default FLASH_NAND
        help
            Please choice flash type

        config FLASH_NAND
            bool "nand flash"
        config FLASH_NOR
            bool "nor flash"
        config FLASH_EMMC
            bool "emmc"
    endchoice

endif

menuconfig GIT_LINUX
    depends on GIT
        bool "linux"
        default y
if GIT_LINUX
    config LINUX_GIT_URL
        string "linux git url"
        default "https://gitee.com/cijliu/linux.git"
endif

menuconfig GIT_ROOTFS
    depends on GIT
        bool rootfs
        default y
if GIT_ROOTFS
    config ROOTFS_GIT_URL
        string "rootfs git url"
        default "https://gitee.com/cijliu/rootfs.git"
    config ROOTFS_JFFS2
        bool "jffs2"
    config ROOTFS_YAFFS
        bool "yaffs"
        default y
endif

config HI3516EV200_MPP
    bool "Hisilicon Media Process Platform"
    depends on HI3516EV200 && HISILICON_MPP
    default y
```

## vendor/Kconfig
```kconfig
menuconfig VERDOR_HISILICON
    bool "Hisilicon"
    depends on HISILICON
    default y

    config HISILICON_MPP
        bool "MPP"
        depends on VERDOR_HISILICON
        default y
        help
            Hisilicon Media Process Platform
```
